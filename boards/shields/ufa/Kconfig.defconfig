## boards/shields/ufa/Kconfig.defconfig
```kconfig
if SHIELD_UFA

config ZMK_KEYBOARD_NAME
    default "Elite Keyboard"

config ZMK_SPLIT
    default y

config ZMK_SPLIT_ROLE_CENTRAL
    default n

endif
```
